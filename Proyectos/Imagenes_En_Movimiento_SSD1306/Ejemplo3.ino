//// https://www.youtube.com/@ArduBrico ////

#include <Wire.h>
#include <Adafruit_GFX.h>
#include <Adafruit_SSD1306.h>

#define SCREEN_WIDTH 128  // Definimos el ancho de nuetra pantalla OLED
#define SCREEN_HEIGHT 64  // Definimos el alto de nuestra pantalla OLED

Adafruit_SSD1306 display(SCREEN_WIDTH, SCREEN_HEIGHT, &Wire, -1);  // Configuramos los parametros para la pantalla

const int botonAbrir = 12;   // Conectamos el pulsador de abrir a D6
const int botonCerrar = 14;  // Conectamos el pulsador de cerrar a D5

int valAbrir = 0;   // Variable para guardar el estado del pulsador "abrir"
int valCerrar = 0;  // Variable para guardar el estado del pulsador "cerrar"

int s = 0;  // Variable que usaremos para mostrar las imagenes de la animación de subir
int a = 0;  // Variable que usaremos para mostrar las imagenes de la animación de "armando alarma"

unsigned long tiempoImagenesPuerta;     // Lo utilizaremos para controlar el tiempo que pasa entre una imagen y otra de las animaciones de la puerta
unsigned long tiempoImagenesArmando;    // Lo utilizaremos para controlar el tiempo que pasa entre una imagen y otra de las animaciones de "armando alarma"
unsigned long tiempomaxImagenes = 400;  // Configuramos el tiempo que queremos que pase entre las imagenes de la animación tanto de a puerta como de "armando alarma"

// A continuación configuramos las imagenes que vamos a mostrar en la pantalla

// Imagen del logo
static const unsigned char PROGMEM logo[] = {
  0x00, 0x00, 0x00, 0x00, 0x00, 0x00, 0x00, 0x00, 0x00, 0x00, 0x00, 0x00, 0x00, 0x00, 0x00, 0x00, 
	0x00, 0x00, 0x00, 0x00, 0x00, 0x00, 0x00, 0x00, 0x00, 0x00, 0x00, 0x00, 0x00, 0x00, 0x00, 0x00, 
	0x00, 0x00, 0x00, 0x00, 0x00, 0x00, 0x00, 0x00, 0x00, 0x00, 0x00, 0x00, 0x00, 0x00, 0x00, 0x00, 
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	0x00, 0x00, 0x00, 0x00, 0x00, 0x00, 0x00, 0x00, 0x00, 0x00, 0x00, 0x00, 0x00, 0x00, 0x00, 0x00
};
// A continuación las imagenes utilizadas para la animación de la puerta
const unsigned char Puerta1[] PROGMEM = {
  0x00, 0x00, 0x00, 0x00, 0x0e, 0x00, 0x00, 0x00, 0x00, 0x00, 0x00, 0x00, 0x00, 0x00, 0x33, 0x80,
  0x00, 0x00, 0x00, 0x00, 0x00, 0x00, 0x00, 0x00, 0xc0, 0xe0, 0x00, 0x00, 0x00, 0x00, 0x00, 0x00,
  0x00, 0x03, 0x00, 0x38, 0x00, 0x00, 0x00, 0x00, 0x00, 0x00, 0x00, 0x0c, 0x1f, 0x0e, 0x00, 0x00,
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  0xff, 0xff, 0xff, 0xff, 0x41, 0x00, 0x1f, 0xff, 0xff, 0xff, 0xff, 0xff, 0xff, 0xff, 0xfe, 0x00
};
const unsigned char Puerta2[] PROGMEM = {
  0x00, 0x00, 0x00, 0x00, 0x0e, 0x00, 0x00, 0x00, 0x00, 0x00, 0x00, 0x00, 0x00, 0x00, 0x33, 0x80,
  0x00, 0x00, 0x00, 0x00, 0x00, 0x00, 0x00, 0x00, 0xc0, 0xe0, 0x00, 0x00, 0x00, 0x00, 0x00, 0x00,
  0x00, 0x03, 0x00, 0x38, 0x00, 0x00, 0x00, 0x00, 0x00, 0x00, 0x00, 0x0c, 0x1f, 0x0e, 0x00, 0x00,
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  0x00, 0x00, 0x00, 0x01, 0x41, 0x00, 0x1f, 0xff, 0xff, 0xff, 0xff, 0xff, 0xff, 0xff, 0xfe, 0x00
};
const unsigned char Puerta3[] PROGMEM = {
  0x00, 0x00, 0x00, 0x00, 0x0e, 0x00, 0x00, 0x00, 0x00, 0x00, 0x00, 0x00, 0x00, 0x00, 0x33, 0x80,
  0x00, 0x00, 0x00, 0x00, 0x00, 0x00, 0x00, 0x00, 0xc0, 0xe0, 0x00, 0x00, 0x00, 0x00, 0x00, 0x00,
  0x00, 0x03, 0x00, 0x38, 0x00, 0x00, 0x00, 0x00, 0x00, 0x00, 0x00, 0x0c, 0x1f, 0x0e, 0x00, 0x00,
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  0x00, 0x00, 0x00, 0x01, 0x41, 0x00, 0x1f, 0xff, 0xff, 0xff, 0xff, 0xff, 0xff, 0xff, 0xfe, 0x00
};
const unsigned char Puerta4[] PROGMEM = {
  0x00, 0x00, 0x00, 0x00, 0x0e, 0x00, 0x00, 0x00, 0x00, 0x00, 0x00, 0x00, 0x00, 0x00, 0x33, 0x80,
  0x00, 0x00, 0x00, 0x00, 0x00, 0x00, 0x00, 0x00, 0xc0, 0xe0, 0x00, 0x00, 0x00, 0x00, 0x00, 0x00,
  0x00, 0x03, 0x00, 0x38, 0x00, 0x00, 0x00, 0x00, 0x00, 0x00, 0x00, 0x0c, 0x1f, 0x0e, 0x00, 0x00,
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  0x00, 0x00, 0x00, 0x01, 0x41, 0x00, 0x1f, 0xff, 0xff, 0xff, 0xff, 0xff, 0xff, 0xff, 0xfe, 0x00
};
const unsigned char Puerta5[] PROGMEM = {
  0x00, 0x00, 0x00, 0x00, 0x0e, 0x00, 0x00, 0x00, 0x00, 0x00, 0x00, 0x00, 0x00, 0x00, 0x33, 0x80,
  0x00, 0x00, 0x00, 0x00, 0x00, 0x00, 0x00, 0x00, 0xc0, 0xe0, 0x00, 0x00, 0x00, 0x00, 0x00, 0x00,
  0x00, 0x03, 0x00, 0x38, 0x00, 0x00, 0x00, 0x00, 0x00, 0x00, 0x00, 0x0c, 0x1f, 0x0e, 0x00, 0x00,
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  0x00, 0x00, 0x00, 0x01, 0x41, 0x00, 0x1f, 0xff, 0xff, 0xff, 0xff, 0xff, 0xff, 0xff, 0xfe, 0x00
};

// Imagen para mostrar alarma desconectada
const unsigned char AlarmaOff[] PROGMEM = {
  0x00, 0x00, 0x00, 0x00, 0x00, 0x00, 0x00, 0x00, 0x00, 0x0c, 0x00, 0x00, 0x00, 0x00, 0x00, 0x00,
  0x7f, 0x00, 0x00, 0x00, 0x00, 0x00, 0x01, 0xff, 0xc0, 0x00, 0x00, 0x00, 0x00, 0x07, 0xff, 0xf0,
  0x00, 0x00, 0x00, 0x00, 0x1f, 0xff, 0xfe, 0x00, 0x00, 0x00, 0x00, 0xff, 0xe3, 0xff, 0x80, 0x00,
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  0x00, 0x00, 0x1c, 0x00, 0x00, 0x00, 0x00, 0x00, 0x00, 0x00, 0x00, 0x00, 0x00, 0x00
};
// Imagen para combinar con alarma modo "Armada ausente" para crear la animación
const unsigned char AlarmaArmando[] PROGMEM = {
  0x00, 0x00, 0x00, 0x00, 0x00, 0x00, 0x00, 0x00, 0x00, 0x00, 0x00, 0x00, 0x00, 0x00, 0x00, 0x00,
  0x00, 0x00, 0x00, 0x00, 0x00, 0x00, 0x00, 0x00, 0x00, 0x00, 0x00, 0x00, 0x00, 0x00, 0x00, 0x00,
  0x00, 0x00, 0x00, 0x00, 0x00, 0x00, 0x00, 0x00, 0x00, 0x00, 0x00, 0x00, 0x00, 0x00, 0x00, 0x00,
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  0x00, 0x00, 0x00, 0x00, 0x00, 0x00, 0x00, 0x00, 0x00, 0x00, 0x00, 0x00, 0x00, 0x00

};
// Usamos un "array" para llamar a la imagen que necesitemos para la animación de la puerta
const unsigned char* imagenes[5] = {
  Puerta1,  // Lo llamaremos con "imagenes[0]"
  Puerta2,  // Lo llamaremos con "imagenes[1]"
  Puerta3,  // Lo llamaremos con "imagenes[2]"
  Puerta4,  // Lo llamaremos con "imagenes[3]"
  Puerta5   // Lo llamaremos con "imagenes[4]"
};
// Usamos un "array" para llamar a la imagen que necesitemos para la animación armando alarma
const unsigned char* imagenes_A[2] = {
  AlarmaOff,     // Lo llamaremos con "imagenes_A[0]"
  AlarmaArmando  // Lo llamaremos con "imagenes_A[1]"
};
void setup() {
  Serial.begin(9600);                                // Iniciamos el Serial
  if (!display.begin(SSD1306_SWITCHCAPVCC, 0x3C)) {  // Si no es correcta la configuración de la pantalla nos muestra un error
    Serial.println(F("SSD1306 allocation failed"));
    for (;;)
      ;
  }

  display.clearDisplay();                      // Limpiamos el buffer de la pantalla
  display.drawBitmap(0, 0, logo, 128, 64, 1);  // Dibujamos el logo en la pantalla
  display.display();                           // Hacemos que se muestre en la pantalla
  delay(3000);                                 // Durante 3 segundos
  display.clearDisplay();                      // Después la limpiamos
  display.display();                           // Hacemos que se muestre en la pantalla

  pinMode(botonCerrar, INPUT_PULLUP);  // Definimos los pulsadores como Pull_Up, no necesitamos resistencias externas
  pinMode(botonAbrir, INPUT_PULLUP);
}

void loop() {
  // PULSADOR ABRIR //

  valAbrir = digitalRead(botonAbrir);  // Leemos el valor del pulsador

  if (valAbrir == LOW) {  // Si el valor a cambiado, de OFF a ON

    subiendo();  // Llamamos a la función "subiendo"
  }

  // PULSADOR ARMAR //

  valCerrar = digitalRead(botonCerrar);  // Leemos el valor del pulsador

  if (valCerrar == LOW) {  // Si el valor a cambiado, de OFF a ON

    armando();  // Llamamos a la función "armando"
  }
}

void subiendo() {

  if (millis() - tiempoImagenesPuerta >= tiempomaxImagenes) {  // Si ha pasado el tiempo configurado para el intervalo de imagenes
    s++;                                                       // Cada vez que ocurre, camniamos el valor de "s" sumando +1
    tiempoImagenesPuerta = millis();                           // Reinicamos el contador para que solo sume cada vez que ha pasado el tiempo estipulado
  }                                                            //
  if (s == 5) {                                                // Cuando el valor de "s" es igual a "5"
    s = 0;                                                     // Debemos ponerlo de nuevo en 0
  }

  display.fillRect(0, 0, 82, 64, 0);                 // Dibujamos un cuadrado negro para borrar la imagen anterior, si usasemos la opcion de "clearDisplay" nos borraría toda la pantalla
  display.drawBitmap(0, 0, imagenes[s], 75, 64, 1);  // Mostramos la imagen llamándola desde el "array" anteriormente configurado,donde la variable de "s" va a ir cambiando entre "0" y "1"
  display.display();                                 // Mostramos la imagen en pantalla
  delay(10);                                         // Le damos un pequeño delay
}

void armando() {

  if (millis() - tiempoImagenesArmando >= tiempomaxImagenes) {  // Si ha pasado el tiempo configurado para el intervalo de imagenes
    a++;                                                        // Cada vez que ocurre, camniamos el valor de "a" sumando +1
    tiempoImagenesArmando = millis();                           // Reinicamos el contador para que solo sume cada vez que ha pasado el tiempo estipulado
  }                                                             //
  if (a == 2) {                                                 // Cuando el valor de "a" es igual a "2"
    a = 0;                                                      // Debemos ponerlo de nuevo en 0
  }

  display.fillRect(82, 9, 64, 64, 0);                   // Dibujamos un cuadrado negro para borrar la imagen anterior, si usasemos la opcion de "clearDisplay" nos borraría toda la pantalla
  display.drawBitmap(82, 9, imagenes_A[a], 50, 50, 1);  // Mostramos la imagen llamándola desde el "array" anteriormente configurado,donde la variable de "a" va a ir cambiando entre "0" y "1"
  display.display();                                    // Mostramos la imagen en pantalla
  delay(10);                                            // Le damos un pequeño delay
}
