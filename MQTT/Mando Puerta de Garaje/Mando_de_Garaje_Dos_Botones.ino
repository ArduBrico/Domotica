//// https://www.youtube.com/@ArduBrico ////

#include <Wire.h>
#include <Adafruit_GFX.h>
#include <Adafruit_SSD1306.h>
#include <ESP8266WiFi.h>
#include <PubSubClient.h>
#include <ArduinoOTA.h>

#define SCREEN_WIDTH 128  // Definimos el ancho de nuetra pantalla OLED
#define SCREEN_HEIGHT 64  // Definimos el alto de nuestra pantalla OLED

Adafruit_SSD1306 display(SCREEN_WIDTH, SCREEN_HEIGHT, &Wire, -1);  // Configuramos los parametros para la pantalla

const char* ssid = "SSID";                 // Configuramos nuestra red Wifi
const char* password = "Password SSID";    // Configuramos la contraseña de nuestra red Wifi
const char* mqtt_server = "xxxxxxxx";      // Configuramos nuestra I.P. EXTERNA de nuestro servidor Home Assistant,por ejemplo, duckdns, etc
int mqttport = 1883;                       // Puerto para MQTT
const char* mqttusuario = "MQTT";          // Configuramos nuestro usuario MQTT
const char* mqttpass = "PASS_MQTT";        // Configuramos contraseña para el usuario MQTT
#define CLIENT_ID "Mando"                  // Configuramos el nombre que le queremos dar al dispositivo
#define Topic_Mando "mando/estado"         // Configuramos el topic para el sensor del mando
#define Topic_Puerta "garaje/puertanueva"  // Configuramos el topic para abrir y cerrar la puerta

const int botonAbrir = 2;                 // Conectamos el pulsador de abrir a D4
const int botonCerrar = 12;               // Conectamos el pulsador de cerrar a D6
const char* estadoGaraje = "Sin estado";  // Creamos una variable para leer el estado de la puerta
int valAbrir = 0;                         // Variable para guardar el estado del pulsador "abrir"
int old_valAbrir = 1;                     // Variable para guardar el estado anteior del pulsador "abrir"
int valCerrar = 0;                        // Variable para guardar el estado del pulsador "cerrar"
int old_valCerrar = 1;                    // Variable para guardar el estado anteior del pulsador "cerrar"
int estado_bajando = 0;                   // Variable para indicar cuando mostrar la animación de bajar
int estado_subiendo = 0;                  // Variable para indicar cuando mostrar la animación de subir
int s = 0;                                // Variable que usaremos para mostrar las imagenes de la animación de subir
int b = 4;                                // Variable que usaremos para mostrar las imagenes de la animación de bajar
unsigned long tiempoBotonAbrirOn;         // Lo utilizaremos para contar el tiempo que está pulsado el botón de abrir, para evitar el "efecto rebote"
unsigned long tiempoBotonCerrarOn;        // Lo utilizaremos para contar el tiempo que está pulsado el botón de cerrar, para evitar el "efecto rebote"
unsigned long tiempoBotonAbrirOff;        // Lo utilizaremos para contar el tiempo que está sin ser pulsado el botón de abrir, para evitar el "efecto rebote"
unsigned long tiempoBotonCerrarOff;       // Lo utilizaremos para contar el tiempo que está sin ser pulsado el botón de cerrar, para evitar el "efecto rebote"
unsigned long tiempoImagenes;             // Lo utilizaremos para controlar el tiempo que pasa entre una imagen y otra de las animaciones
bool flancoBotonAbrirOn = false;          // Variable para saber si ha pasado el tiempo necesario para evitar el "efecto rebote"
bool flancoBotonCerrarOn = false;         // Variable para saber si ha pasado el tiempo necesario para evitar el "efecto rebote"
bool flancoBotonAbrirOff = false;         // Variable para saber si ha pasado el tiempo necesario para evitar el "efecto rebote"
bool flancoBotonCerrarOff = false;        // Variable para saber si ha pasado el tiempo necesario para evitar el "efecto rebote"
unsigned long tiempomax = 150;            // Configuramos el tiempo en milisegundos necesarios para evitar el "efecto rebote"
unsigned long tiempomaxImagenes = 400;    // Configuramos el tiempo que queremos que pase entre las imagenes de la animación

WiFiClient espClient;
PubSubClient client(espClient);

// A continuación configuramos las imagenes que vamos a mostrar en la pantalla

// Imagen del logo
static const unsigned char PROGMEM logo[] = {
  0x00, 0x00, 0x00, 0x00, 0x00, 0x00, 0x00, 0x00, 0x00, 0x00, 0x00, 0x00, 0x00, 0x00, 0x00, 0x00,
  0x00, 0x00, 0x00, 0x00, 0x00, 0x00, 0x00, 0x00, 0x00, 0x00, 0x00, 0x00, 0x00, 0x00, 0x00, 0x00,
  0x00, 0x00, 0x00, 0x00, 0x00, 0x00, 0x00, 0x00, 0x00, 0x00, 0x00, 0x00, 0x00, 0x00, 0x00, 0x00,
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  0x00, 0x00, 0x00, 0x00, 0x00, 0x00, 0x00, 0x00, 0x00, 0x00, 0x00, 0x00, 0x00, 0x00, 0x00, 0x00
};

// A continuación las imagenes utilizadas para la animación de la puerta
const unsigned char Puerta1[] PROGMEM = {
  0x00, 0x00, 0x00, 0x00, 0x0e, 0x00, 0x00, 0x00, 0x00, 0x00, 0x00, 0x00, 0x00, 0x00, 0x33, 0x80,
  0x00, 0x00, 0x00, 0x00, 0x00, 0x00, 0x00, 0x00, 0xc0, 0xe0, 0x00, 0x00, 0x00, 0x00, 0x00, 0x00,
  0x00, 0x03, 0x00, 0x38, 0x00, 0x00, 0x00, 0x00, 0x00, 0x00, 0x00, 0x0c, 0x1f, 0x0e, 0x00, 0x00,
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  0xff, 0xff, 0xff, 0xff, 0x41, 0x00, 0x1f, 0xff, 0xff, 0xff, 0xff, 0xff, 0xff, 0xff, 0xfe, 0x00
};

const unsigned char Puerta2[] PROGMEM = {
  0x00, 0x00, 0x00, 0x00, 0x0e, 0x00, 0x00, 0x00, 0x00, 0x00, 0x00, 0x00, 0x00, 0x00, 0x33, 0x80,
  0x00, 0x00, 0x00, 0x00, 0x00, 0x00, 0x00, 0x00, 0xc0, 0xe0, 0x00, 0x00, 0x00, 0x00, 0x00, 0x00,
  0x00, 0x03, 0x00, 0x38, 0x00, 0x00, 0x00, 0x00, 0x00, 0x00, 0x00, 0x0c, 0x1f, 0x0e, 0x00, 0x00,
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  0x00, 0x00, 0x00, 0x01, 0x41, 0x00, 0x1f, 0xff, 0xff, 0xff, 0xff, 0xff, 0xff, 0xff, 0xfe, 0x00
};

const unsigned char Puerta3[] PROGMEM = {
  0x00, 0x00, 0x00, 0x00, 0x0e, 0x00, 0x00, 0x00, 0x00, 0x00, 0x00, 0x00, 0x00, 0x00, 0x33, 0x80,
  0x00, 0x00, 0x00, 0x00, 0x00, 0x00, 0x00, 0x00, 0xc0, 0xe0, 0x00, 0x00, 0x00, 0x00, 0x00, 0x00,
  0x00, 0x03, 0x00, 0x38, 0x00, 0x00, 0x00, 0x00, 0x00, 0x00, 0x00, 0x0c, 0x1f, 0x0e, 0x00, 0x00,
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  0x00, 0x00, 0x00, 0x01, 0x41, 0x00, 0x1f, 0xff, 0xff, 0xff, 0xff, 0xff, 0xff, 0xff, 0xfe, 0x00
};

const unsigned char Puerta4[] PROGMEM = {
  0x00, 0x00, 0x00, 0x00, 0x0e, 0x00, 0x00, 0x00, 0x00, 0x00, 0x00, 0x00, 0x00, 0x00, 0x33, 0x80,
  0x00, 0x00, 0x00, 0x00, 0x00, 0x00, 0x00, 0x00, 0xc0, 0xe0, 0x00, 0x00, 0x00, 0x00, 0x00, 0x00,
  0x00, 0x03, 0x00, 0x38, 0x00, 0x00, 0x00, 0x00, 0x00, 0x00, 0x00, 0x0c, 0x1f, 0x0e, 0x00, 0x00,
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  0x00, 0x00, 0x00, 0x01, 0x41, 0x00, 0x1f, 0xff, 0xff, 0xff, 0xff, 0xff, 0xff, 0xff, 0xfe, 0x00
};

const unsigned char Puerta5[] PROGMEM = {
  0x00, 0x00, 0x00, 0x00, 0x0e, 0x00, 0x00, 0x00, 0x00, 0x00, 0x00, 0x00, 0x00, 0x00, 0x33, 0x80,
  0x00, 0x00, 0x00, 0x00, 0x00, 0x00, 0x00, 0x00, 0xc0, 0xe0, 0x00, 0x00, 0x00, 0x00, 0x00, 0x00,
  0x00, 0x03, 0x00, 0x38, 0x00, 0x00, 0x00, 0x00, 0x00, 0x00, 0x00, 0x0c, 0x1f, 0x0e, 0x00, 0x00,
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  0x00, 0x00, 0x00, 0x01, 0x41, 0x00, 0x1f, 0xff, 0xff, 0xff, 0xff, 0xff, 0xff, 0xff, 0xfe, 0x00
};
// Imagen para mostrar desconexión de Wifi
const unsigned char WifiOff[] PROGMEM = {
  0x00, 0x00, 0x00, 0x00, 0x00, 0x00, 0x00, 0x00, 0x00, 0x00, 0x00, 0x00, 0x00, 0x00, 0x00, 0x00,
  0x00, 0x00, 0x00, 0x00, 0x00, 0x00, 0x00, 0x00, 0x00, 0x00, 0x00, 0x00, 0x00, 0x00, 0x00, 0x00,
  0x00, 0x00, 0x00, 0x00, 0x00, 0x00, 0x00, 0x00, 0x06, 0x00, 0x00, 0x00, 0x00, 0x00, 0x00, 0x00,
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  0x00, 0x00, 0x00, 0x00, 0x00, 0x00, 0x00, 0x00, 0x00, 0x00, 0x00, 0x00, 0x00, 0x00, 0x00, 0x00
};
// Usamos un "array" para llamar a la imagen que necesitemos en cada momento
const unsigned char* imagenes[5] = {
  Puerta1,  // Lo llamaremos con "imagenes[0]"
  Puerta2,  // Lo llamaremos con "imagenes[1]"
  Puerta3,  // Lo llamaremos con "imagenes[2]"
  Puerta4,  // Lo llamaremos con "imagenes[3]"
  Puerta5   // Lo llamaremos con "imagenes[4]"
};

void setup() {
  Serial.begin(9600);                                // Iniciamos el Serial
  if (!display.begin(SSD1306_SWITCHCAPVCC, 0x3C)) {  // Si no es correcta la configuración de la pantalla nos muestra un error
    Serial.println(F("SSD1306 allocation failed"));
    for (;;)
      ;
  }

  display.clearDisplay();                      // Limpiamos el buffer de la pantalla
  display.drawBitmap(0, 0, logo, 128, 64, 1);  // Dibujamos el logo en la pantalla
  display.display();                           // Hacemos que se muestre en la pantalla
  delay(3000);                                 // Durante 3 segundos
  display.clearDisplay();                      // Después la limpiamos

  pinMode(botonCerrar, INPUT_PULLUP);  // Definimos los pulsadores como Pull_Up, no necesitamos resistencias externas
  pinMode(botonAbrir, INPUT_PULLUP);

  // Iniciamos el Wifi
  setup_wifi();
  client.setServer(mqtt_server, 1883);
  client.setCallback(callback);

  // Iniciamos OTA
  ArduinoOTA.setHostname(CLIENT_ID);
  ArduinoOTA.onStart([]() {
    Serial.println("Start");
  });
  ArduinoOTA.onEnd([]() {
    Serial.println("\nEnd");
  });
  ArduinoOTA.onProgress([](unsigned int progress, unsigned int total) {
    Serial.printf("Progress: %u%%\r", (progress / (total / 100)));
  });
  ArduinoOTA.onError([](ota_error_t error) {
    Serial.printf("Error[%u]: ", error);
    if (error == OTA_AUTH_ERROR) Serial.println("Auth Failed");
    else if (error == OTA_BEGIN_ERROR) Serial.println("Begin Failed");
    else if (error == OTA_CONNECT_ERROR) Serial.println("Connect Failed");
    else if (error == OTA_RECEIVE_ERROR) Serial.println("Receive Failed");
    else if (error == OTA_END_ERROR) Serial.println("End Failed");
  });
  ArduinoOTA.begin();
}

void loop() {

  ArduinoOTA.handle();

  // PULSADOR ABRIR //

  valAbrir = digitalRead(botonAbrir);  // Leemos el valor del pulsador

  if ((valAbrir == LOW) && (old_valAbrir == 1)) {          // Si el valor a cambiado, de OFF a ON
    tiempoBotonAbrirOn = millis();                         // Empezamos a contar el tiempo
    flancoBotonAbrirOn = true;                             // Ponemos el flanco en verdadero
  } else if ((valAbrir == HIGH) && (old_valAbrir == 0)) {  // Si el valor a cambiado, de ON a OFF
    tiempoBotonAbrirOff = millis();                        // Empezamos a contar el tiempo
    flancoBotonAbrirOff = true;                            // Ponemos el flanco en verdadero
  }

  old_valAbrir = valAbrir;  // Igualamos de nuevo los valores

  if (flancoBotonAbrirOn && (valAbrir == LOW))         // Si el pulsador de abrir continua pulsado
    if (millis() - tiempoBotonAbrirOn >= tiempomax) {  // Y ha pasado el tiempo configurado para evitar el "efecto rebote"
      client.publish(Topic_Mando, "Abrir On", true);   // Enviamos el mensaje "Abrir On" al sensor de mando de Home Assistant
      client.publish(Topic_Puerta "/comando", "1");    // Enviamos la orden de abrir la puerta al topic de Home Assistant
      flancoBotonAbrirOn = false;                      // Ponemos el flanco en "falso" para que se envíe solo una vez con cada pulsación
    }

  if (flancoBotonAbrirOff && (valAbrir == HIGH))        // Si el pulsador no se pulsa
    if (millis() - tiempoBotonAbrirOff >= tiempomax) {  // Y ha pasado el tiempo configurado para evitar el "efecto rebote"
      client.publish(Topic_Mando, "Off", true);         // Enviamos el mensaje "Off" al sensor de mando de Home Assistant
      flancoBotonAbrirOff = false;                      // Ponemos el flanco en "falso" para que no se envien mensajes constantemente si no se pulsa
    }

  // PULSADOR CERRAR //

  valCerrar = digitalRead(botonCerrar);

  if ((valCerrar == LOW) && (old_valCerrar == 1)) {
    tiempoBotonCerrarOn = millis();
    flancoBotonCerrarOn = true;
  } else if ((valCerrar == HIGH) && (old_valCerrar == 0)) {
    tiempoBotonCerrarOff = millis();
    flancoBotonCerrarOff = true;
  }

  old_valCerrar = valCerrar;

  if (flancoBotonCerrarOn && (valCerrar == LOW))
    if (millis() - tiempoBotonCerrarOn >= tiempomax) {
      client.publish(Topic_Puerta "/comando", "2");
      flancoBotonCerrarOn = false;
    }

  if (flancoBotonCerrarOff && (valCerrar == HIGH))
    if (millis() - tiempoBotonCerrarOff >= tiempomax) {
      client.publish(Topic_Mando, "Off", true);
      flancoBotonCerrarOff = false;
    }

  if (estado_subiendo == 1) {        // Si hemos recibido el mensaje de puerta subiendo
    subiendo();                      // Llamamos a la instrucción "subiendo"
  } else if (estado_bajando == 1) {  // Si hemos recibido el mensaje de puerta bajando
    bajando();                       // Llamamos a la instrucción "bajando"
  }


  if (WiFi.status() != WL_CONNECTED) {        // Si no estamos conectados a Wifi y "flancowifi" está activado:
    setup_wifi();                             // Llamamos a la funcion "setup_wifi"
    reconnect();                              // Llamamos a la funcion "reconnect"
    client.setServer(mqtt_server, mqttport);  // Iniciamos "setServer" con los datos porpocionados
    client.setCallback(callback);             // Iniciamos "Callback" para recibir mensajes de MQTT
  }
  if (!client.connected()) {  // Si seguimos sin estar conectados:
    reconnect();              // Llamamos a la funcion "reconnect"
  }
  client.loop();  // Esta función revisa en cada ciclo si hay que enviar o leer mensaje por MQTT
}

void subiendo() {

  if (millis() - tiempoImagenes >= tiempomaxImagenes) {  // Si ha pasado el tiempo configurado para el intervalo de imagenes
    s++;                                                 // Cada vez que ocurre, camniamos el valor de "s" sumando +1
    tiempoImagenes = millis();                           // Reinicamos el contador para que solo sume cada vez que ha pasado el tiempo estipulado
  }                                                      //
  if (s == 5) {                                          // Cuando el valor de "s" es igual a "5"
    s = 0;                                               // Debemos ponerlo de nuevo en 0
  }

  display.fillRect(30, 0, 82, 64, 0);                 // Dibujamos un cuadrado negro para borrar la imagen anterior, si usasemos la opcion de "clearDisplay" nos borraría toda la pantalla
  display.drawBitmap(30, 0, imagenes[s], 75, 64, 1);  // Mostramos la imagen llamándola desde el "array" anteriormente configurado,donde la variable de "s" va a ir cambiando entre "0" y "4"
  display.display();                                  // Mostramos la imagen en pantalla
  delay(10);                                          // Le damos un pequeño delay
}

void bajando() {

  if (millis() - tiempoImagenes >= tiempomaxImagenes) {  // Si ha pasado el tiempo configurado para el intervalo de imagenes
    b--;                                                 // Cada vez que ocurre, camniamos el valor de "b" restando -1
    tiempoImagenes = millis();                           // Reinicamos el contador para que solo sume cada vez que ha pasado el tiempo estipulado
  }                                                      //
  if (b == -1) {                                         // Cuando el valor de "b" es igual a "-1"
    b = 4;                                               // Debemos ponerlo de nuevo en 4
  }

  display.fillRect(30, 0, 82, 64, 0);                 // Dibujamos un cuadrado negro para borrar la imagen anterior, si usasemos la opcion de "clearDisplay" nos borraría toda la pantalla
  display.drawBitmap(30, 0, imagenes[b], 75, 64, 1);  // Mostramos la imagen llamándola desde el "array" anteriormente configurado,donde la variable de "b" va a ir cambiando entre "0" y "4"
  display.display();                                  // Mostramos la imagen en pantalla
  delay(10);                                          // Le damos un pequeño delay
}

void setup_wifi() {  // Configuración para conectar a Wifi
  delay(10);
  Serial.println();
  Serial.print("Conectado a: ");  //  Mostramos por serial el Wifi que nos queremos conectar
  Serial.println(ssid);           // Muestra el "SSID" que configuramos
  WiFi.mode(WIFI_STA);            // Configuración de tipo de conexión
  WiFi.begin(ssid, password);     // Configuración de nombre de "SSID" y su password

  while (WiFi.status() != WL_CONNECTED) {           // Si no estamos conectados a Wifi
    display.clearDisplay();                         // Limpiamos el buffer de la pantalla
    display.drawBitmap(30, 0, WifiOff, 64, 64, 1);  // Dibujamos la imagen de desconexión de Wifi
    display.display();                              // lo mostramos en pantalla
    for (int i = 0; i <= 50; i++) {                 // Iniciamos una cuenta para la espera de la conexión
      delay(10);
      if (i == 50) {
        Serial.println(".");
      } else {
        Serial.print(".");
      }
    }
  }
  Serial.println("");
  Serial.println("Conectado a WIFI");  // Mostramos por serial que hemos conectado a Wifi
  Serial.println("Dirección IP: ");    // Mostramos la IP asignada
  Serial.println(WiFi.localIP());
}

void callback(char* topic, byte* payload, unsigned int length) {  // Función para poder recibir los mensajes por MQTT
  Serial.print("Mensaje recibido [");                             // Mostramos por serial cuando recibimos un mensaje
  Serial.print(topic);                                            // Mostramos el topic que recibimos
  Serial.print("] ");                                             //
  for (int i = 0; i < length; i++) {                              //
    Serial.print((char)payload[i]);                               // Muestra el mensaje
  }
  Serial.println();

  ///// LEE EL ESTADO DE LA PUERTA DEL GARAJE////

  if (strcmp(topic, Topic_Puerta "/estado") == 0) {   // Si recibimos un mensaje del topic del estado de la puerta
    if ((char)payload[0] == '1') {                    // Si el mensaje es "1" (Puerta cerrada)
      delay(10);                                      //
      ;                                               //
      display.fillRect(30, 0, 82, 64, 0);             // Borramos la imagen anterior dibujando un cuadrado negro
      display.drawBitmap(30, 0, Puerta5, 75, 64, 1);  // Mostramos la imagen de puerta cerrada
      display.display();                              // Lo mostramos en pantalla
      estado_bajando = 0;                             // Ponemos el estado de "bajando" en 0
      estado_subiendo = 0;                            // Ponemos el estado de "subiendo" en 0
    }

    else if ((char)payload[0] == '2') {  // Si el mensaje es "2" (Puerta abriendo)
      delay(10);
      ;
      estado_bajando = 0;         // Ponemos estado "bajando" en "0"
      estado_subiendo = 1;        // Ponemos estado "subiendo" en "1"
      tiempoImagenes = millis();  // Registramos el tiempo actual en "tiempoImagenes"

    } else if ((char)payload[0] == '3') {  // Si el mensaje es "3" (Puerta abierta)
      delay(10);
      ;
      display.fillRect(30, 0, 82, 64, 0);             // Borramos la imagen anterior dibujando un cuadrado negro
      display.drawBitmap(30, 0, Puerta1, 75, 64, 1);  // Mostramos la imagen de puerta abierta
      display.display();                              // Lo mostramos en pantalla
      estado_bajando = 0;                             // Ponemos el estado de "bajando" en 0
      estado_subiendo = 0;                            // Ponemos el estado de "subiendo" en 0
    }

    else if ((char)payload[0] == '4') {  // Si el mensaje es "4" (Puerta cerrando)
      delay(10);
      ;
      estado_bajando = 1;         // Ponemos estado "bajando" en "1"
      estado_subiendo = 0;        // Ponemos estado "subiendo" en "0"
      tiempoImagenes = millis();  // Registramos el tiempo actual en "tiempoImagenes"
    }
  }

  else {
    delay(10);
    ;
  }
}
void reconnect() {

  while (!client.connected()) {              // Si no estamos conectados a MQTT
    Serial.print("Conectando con MQTT...");  // Mostramos por serial que estamos intentando conectar
    display.clearDisplay();
    display.drawBitmap(30, 0, WifiOff, 64, 64, 1);  // Mientras no está conectado mostramos la imagen de no conexión
    display.display();                              // Lo mostramos en pantalla

    if (client.connect(CLIENT_ID, mqttusuario, mqttpass)) {  // Si conectamos a Wifi, establecemos la configuración para conectarnos
      client.subscribe(Topic_Puerta "/estado");              // Nos suscribimos a los topic para recibir el estado de la puerta
    } else {                                                 // Si no hemos podido conectar:
      Serial.print("failed, rc=");                           // Mostramos por serial un mensaje del fallo
      Serial.print(client.state());
      Serial.println(" nuevo intento en 5 segundos...");

      for (int i = 0; i <= 500; i++) {  // Creamos un "for" para crear una espera mientras intenta la conexión
        delay(10);
        if (i == 50) {
          Serial.println(".");
        } else {
          Serial.print(".");
        }
      }
    }
  }
}